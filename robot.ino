#define S1Trig 2


#define S2Trig 4


#define S3Trig 10


#define S1Echo 3


#define S2Echo 5


#define S3Echo 11


// Motor control pins


#define LEFT_MOTOR_PIN1 7


#define LEFT_MOTOR_PIN2 8


#define RIGHT_MOTOR_PIN1 12


#define RIGHT_MOTOR_PIN2 13


// Distance thresholds for obstacle detection


#define MAX_DISTANCE 40


#define MIN_DISTANCE_BACK 5


// Maximum and minimum motor speeds


#define MAX_SPEED 150


#define MIN_SPEED 75

const byte voicePins[] PROGMEM = {A0, A1, A2, A3, A4, A5};

byte voiceEnabled[6];
byte voiceType[6];
byte states[6];
byte noiseCount[6];
unsigned long start[6];
unsigned int periods[6];
unsigned long nextFlip[6];
byte noise = 0;
unsigned long t = 0;
byte tFlip = 0;
unsigned long nextCommandTime = 0;
bool songPlaying = false;

const unsigned int frequencies[89] PROGMEM = {
  0, 27, 29, 30,
  33, 35, 37, 39, 41, 44, 46, 49, 52, 55, 58, 62,
  65, 69, 73, 78, 82, 87, 92, 98, 104, 110, 116, 123,
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  4186,
};

const byte score [] PROGMEM = {
0x90,39, 0x91,126, 0,87, 0x81, 0,13, 0x91,127, 0,87, 0x80, 0,4, 0x81, 0,8, 0x90,51, 0x91,127, 0,92, 0x80, 
0x81, 0,8, 0x90,51, 0x91,127, 0,92, 0x80, 0x81, 0,8, 0x90,40, 0x91,126, 0,88, 0x81, 0,12, 0x91,127, 0,88, 
0x80, 0,4, 0x81, 0,8, 0x90,52, 0x91,127, 0,92, 0x80, 0x81, 0,8, 0x90,52, 0x91,127, 0,92, 0x80, 0x81, 0,8, 
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0x93,60, 0x94,127, 0,25, 0x91,58, 0x84, 0,25, 0x90,56, 0x81, 0x82, 0x83, 0,25, 0x80, 2,108, 0xF0};


unsigned int index = sizeof(score);

void setup() {


  // Set motor control pins as outputs


  pinMode(LEFT_MOTOR_PIN1, OUTPUT);


  pinMode(LEFT_MOTOR_PIN2, OUTPUT);


  pinMode(RIGHT_MOTOR_PIN1, OUTPUT);


  pinMode(RIGHT_MOTOR_PIN2, OUTPUT);


  //Set the Trig pins as output pins


  pinMode(S1Trig, OUTPUT);


  pinMode(S2Trig, OUTPUT);


  pinMode(S3Trig, OUTPUT);


  //Set the Echo pins as input pins


  pinMode(S1Echo, INPUT);


  pinMode(S2Echo, INPUT);


  pinMode(S3Echo, INPUT);


  // Initialize the serial communication for debugging


  Serial.begin(9600);

songPlay();
}




// Function to measure the distance using an ultrasonic sensor


int sensorOne() {


  //pulse output


  digitalWrite(S1Trig, LOW);





  digitalWrite(S1Trig, HIGH);





  digitalWrite(S1Trig, LOW);


  long t = pulseIn(S1Echo, HIGH);//Get the pulse


  int cm = t / 29 / 2; //Convert time to the distance


  return cm; // Return the values from the sensor


}


//Get the sensor values


int sensorTwo() {


  //pulse output


  digitalWrite(S2Trig, LOW);





  digitalWrite(S2Trig, HIGH);





  digitalWrite(S2Trig, LOW);


  long t = pulseIn(S2Echo, HIGH);//Get the pulse


  int cm = t / 29 / 2; //Convert time to the distance


  return cm; // Return the values from the sensor


}


//Get the sensor values


int sensorThree() {


  //pulse output


  digitalWrite(S3Trig, LOW);





  digitalWrite(S3Trig, HIGH);





  digitalWrite(S3Trig, LOW);


  long t = pulseIn(S3Echo, HIGH);//Get the pulse


  int cm = t / 29 / 2; //Convert time to the distance


  return cm; // Return the values from the sensor


}


// Motor control functions

void moveForward() {

  analogWrite(LEFT_MOTOR_PIN1, LOW);


  analogWrite(LEFT_MOTOR_PIN2, MAX_SPEED);


  analogWrite(RIGHT_MOTOR_PIN1, LOW);


  analogWrite(RIGHT_MOTOR_PIN2, MAX_SPEED);



}


void moveBackward() {


  analogWrite(LEFT_MOTOR_PIN1, LOW);


  analogWrite(LEFT_MOTOR_PIN2, MAX_SPEED);


  analogWrite(RIGHT_MOTOR_PIN1, LOW);


  analogWrite(RIGHT_MOTOR_PIN2, MAX_SPEED);


}


void turnRight() {

  analogWrite(LEFT_MOTOR_PIN1, LOW);


  analogWrite(LEFT_MOTOR_PIN2, MAX_SPEED);


  analogWrite(RIGHT_MOTOR_PIN1, MAX_SPEED);


  analogWrite(RIGHT_MOTOR_PIN2, LOW);


}


void turnLeft() {


  analogWrite(LEFT_MOTOR_PIN1, MAX_SPEED);


  analogWrite(LEFT_MOTOR_PIN2, LOW);


  analogWrite(RIGHT_MOTOR_PIN1, LOW);


  analogWrite(RIGHT_MOTOR_PIN2, MAX_SPEED);


}


void stop() {


  analogWrite(LEFT_MOTOR_PIN1, LOW);


  analogWrite(LEFT_MOTOR_PIN2, LOW);


  analogWrite(RIGHT_MOTOR_PIN1, LOW);


  analogWrite(RIGHT_MOTOR_PIN2, LOW);
}

void checkMotor() {
  int frontDistance = sensorOne();


  int leftDistance = sensorTwo();


  int rightDistance = sensorThree();


  Serial.print("Front: ");


  Serial.print(frontDistance);


  Serial.print(" cm, Left: ");


  Serial.print(leftDistance);


  Serial.print(" cm, Right: ");


  Serial.print(rightDistance);


  Serial.println(" cm");


  // Find the sensor with the smallest distance

  if (frontDistance < MIN_DISTANCE_BACK) {


    stop();

    Serial.println("stop!");
    


  } else if (frontDistance < leftDistance && frontDistance < rightDistance && frontDistance < MAX_DISTANCE) {


    moveForward();


    Serial.println("forward");


  }else if (leftDistance < rightDistance && leftDistance < MAX_DISTANCE) {


    turnLeft();


    Serial.println("left");


  } else if (rightDistance < leftDistance && rightDistance < MAX_DISTANCE) {

    turnRight();

    Serial.println("right");
  }
}

void songWait() {
  while (songPlaying) {
    delay(1);
  }
}

void songStop() {
  songPlaying = false;
  index = sizeof(score);
  for (byte i = 0; i < 6; i++) {
    voiceEnabled[i] = 0;
    voiceType[i] = 0;
    start[i] = 0;
    states[i] = 0;
    periods[i] = 0;
    nextFlip[i] = 0;
  }
}

void songPlay() {
  index = 0;
  songPlaying = true;

  for (byte i = 0; i < 6; i++) {
    byte p = pgm_read_byte (voicePins + i);
    pinMode(p, INPUT_PULLUP);
  }

  // TIMER 2 for interrupt frequency 1000 Hz:
  cli(); // stop interrupts
  TCCR2A = 0; // set entire TCCR0A register to 0
  TCCR2B = 0; // same for TCCR0B
  TCNT2  = 0; // initialize counter value to 0
  // set compare match register for 1000 Hz increments
  OCR2A = 249; // = 16000000 / (64 * 1000) - 1 (must be <256)
  // turn on CTC mode
  TCCR2B |= (1 << WGM21);
  // Set CS02, CS01 and CS00 bits for 64 prescaler
  TCCR2B |= (0 << CS22) | (1 << CS21) | (1 << CS20);
  // enable timer compare interrupt
  TIMSK2 |= (1 << OCIE2A);
  sei(); // allow interrupts

  // TIMER 1 for interrupt frequency 22050 Hz:
  cli(); // stop interrupts
  TCCR1A = 0; // set entire TCCR1A register to 0
  TCCR1B = 0; // same for TCCR1B
  TCNT1  = 0; // initialize counter value to 0
  // set compare match register for 25000 Hz increments
  OCR1A = 750; // = 16000000 / (1 * 22050) - 1 (must be <65536)
  // turn on CTC mode
  TCCR1B |= (1 << WGM12);
  // Set CS12, CS11 and CS10 bits for 1 prescaler
  TCCR1B |= (0 << CS12) | (0 << CS11) | (1 << CS10);
  // enable timer compare interrupt
  TIMSK1 |= (1 << OCIE1A);
  sei(); // allow interrupts
}

byte rng() {
  static unsigned int y = 0;
  y += t; // seeded with changing number
  y ^= y >> 7;
  y ^= y << 7;
  return (y);
}

void startVoice(byte voice, unsigned int frequency) {
  byte p = pgm_read_byte (voicePins + voice);
  pinMode(p, OUTPUT);

  if (frequency < 27) { // off piano, must be percussion
    voiceType[voice] = 1 + frequency;
    voiceEnabled[voice] = 1;
    periods[voice] = 1;
    start[voice] = t;
  }
  else {
    periods[voice] = 1000000 / frequency / 2;
    nextFlip[voice] = t + periods[voice];
    voiceEnabled[voice] = 1;
    voiceType[voice] = 0;
  }
}

ISR(TIMER2_COMPA_vect) {
  if (t >= nextCommandTime) {
    if (index < sizeof(score)) {
      byte command = pgm_read_byte (score + index);
      byte type = bitRead(command, 7);

      byte val1 = 0;
      for (byte i = 0; i < 4; i++) {
        bitWrite(val1, i, bitRead(command, i + 4));
      }

      byte val2 = 0;
      for (byte i = 0; i < 4; i++) {
        bitWrite(val2, i, bitRead(command, i));
      }

      type = bitRead(command, 7);

      if (type == 1) {
      
        if (val1 == 0x9) {
          
          byte note = pgm_read_byte (score + index + 1);
          byte voice = val2;

          unsigned int freq = 0;
          if (note > 108) { // IF HIGHER THAN PIANO RANGE, USE PERCUSSION
            freq = 127 - note; // FREQUENCY NOW DECIDES PERCUSSION TYPE
          }
          else { // If we're in piano range, produce the corresponding frequency
            freq = pgm_read_word(frequencies + note - 20);
          }
          startVoice(voice, freq);

          index += 2;
   
        }
        if (val1 == 0x8) {
          byte voice = val2;

          voiceEnabled[voice] = 0;
          byte p = pgm_read_byte (voicePins + voice);
          pinMode(p, INPUT_PULLUP);
          index += 1; 
        }
        if (val1 == 0xE) {
          index = 0;
        }      
        if (val1 == 0xF) {
          songStop();
        }              
      }
      else if (type == 0) {
        byte next = pgm_read_byte (score + index + 1);

        unsigned long wait = 0;
        for (byte i = 0; i < 7; i++) {
          bitWrite(wait, i + 8, bitRead(command, i));
        }
        for (byte i = 0; i < 8; i++) {
          bitWrite(wait, i, bitRead(next, i));
        }

        nextCommandTime = t + (wait * 965); // not an exact ms value, tuned faster to make up for some slow code
        index += 2;
      }
    }
  }

  //limit hh closed and kick durations
  for (byte i = 0; i < 6; i++) {
    if (voiceType[i] == 1 || voiceType[i] == 2 || voiceType[i] == 3) {
      if (t - start[i] >= 30000) {
        voiceEnabled[i] = 0;
        voiceType[i] = 0;
        start[i] = 0;
        byte p = pgm_read_byte (voicePins + i);
        pinMode(p, INPUT_PULLUP);
      }
    }

    // limit fast snare durations
    if (voiceType[i] == 4) {
      if (t - start[i] >= 80000) {
        voiceEnabled[i] = 0;
        voiceType[i] = 0;
        start[i] = 0;
        byte p = pgm_read_byte (voicePins + i);
        pinMode(p, INPUT_PULLUP);
      }
    }
  }
}

ISR(TIMER1_COMPA_vect) {
  t = micros();
  
  bool newNoise = false;
  for (byte i = 0; i < 6; i++) {
    if (voiceEnabled[i] == 1) {
      byte p = pgm_read_byte (voicePins + i);
      byte state = 0;
      if (voiceType[i] == 0) {
        if (t > nextFlip[i]) {
          nextFlip[i] += periods[i];
          states[i] = !states[i];
          digitalWrite(p, states[i]);
        }
      }
      else if (voiceType[i] == 1 || voiceType[i] == 4) {
        if (newNoise == false) {
          newNoise = true;
          noise = bitRead(rng(), 0);
        }
        digitalWrite(p, noise);
      }
      else if (voiceType[i] == 2) {
        if (noiseCount[i] == 2) {
          noiseCount[i] = 0;
          if (newNoise == false) {
            newNoise = true;
            noise = bitRead(rng(), 0);
          }
          digitalWrite(p, noise);
        }
        else {
          noiseCount[i]++;
        }
      }
      else if (voiceType[i] == 3) {
        if (noiseCount[i] == 3) {
          noiseCount[i] = 0;
          if (newNoise == false) {
            newNoise = true;
            noise = bitRead(rng(), 0);
          }
          digitalWrite(p, noise);
        }
        else {
          noiseCount[i]++;
        }
      }
    }
  }
}

unsigned long songStartTime = 0;
unsigned long lastSensorTime = 0;
const unsigned long sensorInterval = 100;
const unsigned long songInterval = 185000;

void loop() {
  //Millis function: the checkMotor function will happen every 100 ms and the song will restart every 185000 ms, or 2.
  unsigned long currentTime = millis();
  // Check motor status
  if (currentTime - lastSensorTime >= sensorInterval) {
    // Update the last sensor reading time
    lastSensorTime = currentTime;

    // Check motor status
    checkMotor();
  }
  if (currentTime - songStartTime >= songInterval) {
    // Update the last sensor reading time
    songStartTime = currentTime;

    // Check motor status
     
     songPlay();
  }
} 